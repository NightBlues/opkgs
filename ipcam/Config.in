## ipcam/Config.in
```kconfig
config IPCAM_TELEGRAM_TOKEN
	string "Telegram TOKEN"
	depends on PACKAGE_ipcam
	default "xxxxxxxxx:yyyyyyyyyyyyyyyyyyyyyyyyyyyyyyyyyyy"
	help
      TOKEN for telegram bot to send notifications

config IPCAM_TELEGRAM_CHAT_ID
	int "Telegram CHAT_ID"
	depends on PACKAGE_ipcam
	default 000000000
	help
      Chat id for telegram bot where to send notifications

config IPCAM_CAMERA_NAME
	string "Motion camera_name"
	depends on PACKAGE_ipcam
	default "MyCam1"
	help
      Motion param camera_name

config IPCAM_CAMERA_ID
	int "Motion camera_id"
	depends on PACKAGE_ipcam
	default 100
	help
      Motion param camera_id

config IPCAM_CAMERA_URL
	string "Motion camera_url"
	depends on PACKAGE_ipcam
	default "rtsp://admin:PASSWORD@192.168.2.64:554/"
	help
      Motion param camera_url

config IPCAM_TARGET_DIR_ALL
	string "Motion target_dir for camera-all"
	depends on PACKAGE_ipcam
	default "/storage/camera-all"
	help
      Motion param target_dir for motion-all config

config IPCAM_TARGET_DIR
	string "Motion target_dir for camera (detection process)"
	depends on PACKAGE_ipcam
	default "/storage/camera"
	help
      Motion param target_dir for motion config (detection process)

config IPCAM_STORAGE_DEVICE
	string "Device for /storage (path or uid)"
	depends on PACKAGE_ipcam
	default "/dev/sda1"
	help
      Device for /storage (path or uid)

config IPCAM_WG_PRIV_KEY
	string "Wireguard private key"
	depends on PACKAGE_ipcam
	default "XXXXXXXXXX"
	help
      Wireguard private key of this device

config IPCAM_WG_SRV_PUB_KEY
	string "Wireguard public key of the server"
	depends on PACKAGE_ipcam
	default "XXXXXXXXXX"
	help
      Wireguard public key of server that connects all devices into one network

config IPCAM_WG_SRV_PUB_HOST
	string "Wireguard endpoint host of the server"
	depends on PACKAGE_ipcam
	default "mywgserver.org"
	help
      Wireguard endpoint host of server that connects all devices into one network


config IPCAM_WG_SRV_PUB_PORT
	int "Wireguard endpoint port of the server"
	depends on PACKAGE_ipcam
	default 51820
	help
      Wireguard endpoint port of server that connects all devices into one network

config IPCAM_WG_IP
	string "Wireguard local ip"
	depends on PACKAGE_ipcam
	default "192.168.3.7/32"
	help
      Wireguard local ip on wg0 interface, also allowedip for others

config IPCAM_WG_PREFIX
	string "Wireguard local prefix"
	depends on PACKAGE_ipcam
	default "192.168.3.0/24"
	help
      Wireguard local prefix on wg0 interface, also allowedip for us

config IPCAM_WG_LAN_IPADDR
	string "Our Lan prefix/ipaddr"
	depends on PACKAGE_ipcam
	default "192.168.22.1/24"
	help
      Just reconfiguration of default lan's 192.168.1.1/24

config IPCAM_CAM1_MAC_ADDR
	string "MAC addr of ipcam for dhcp static lease"
	depends on PACKAGE_ipcam
	default "XX:XX:XX:XX:XX:XX"
	help
      MAC addr of ipcam for dhcp static lease

config IPCAM_CAM1_IP
	string "IP addr of ipcam for dhcp static lease"
	depends on PACKAGE_ipcam
	default "192.168.22.64"
	help
      IP addr of ipcam for dhcp static lease
```
